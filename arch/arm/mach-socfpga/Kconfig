## arch/arm/mach-socfpga/Kconfig
```kconfig
if ARCH_SOCFPGA

config SOCFPGA_SDRAM_SBE_ECC_CHECKING
	bool "SDRAM single bit error ECC checking"
	help
	 Enable SDRAM single bit error ECC checking.
	 There are a few combination you can run:
	 1. sdram_sbe_ecc_checking only.
	 2. sdram_sbe_ecc_checking -> sdram_dbe_ecc_checking.
	 3. sdram_sbe_ecc_checking -> sdram_addr_mismatch_ecc_checking.

config SOCFPGA_SDRAM_DBE_ECC_CHECKING
	bool "SDRAM double bit error ECC checking"
	help
	 Enable SDRAM double bit error ECC checking.
	 There are a few combination you can run:
	 1. sdram_dbe_ecc_checking only.
	 2. sdram_sbe_ecc_checking -> sdram_dbe_ecc_checking.

config SOCFPGA_SDRAM_ADDR_MISMATCH_ECC_CHECKING
	bool "SDRAM address mismatch ECC checking"
	help
	 Enable SDRAM address mismatch ECC checking.
	 There are a few combination you can run:
	 1. sdram_addr_mismatch_ecc_checking only.
	 2. sdram_sbe_ecc_checking -> sdram_addr_mismatch_ecc_checking.

config SPL_LIBCOMMON_SUPPORT
	default y

config SPL_LIBDISK_SUPPORT
	default y

config SPL_LIBGENERIC_SUPPORT
	default y

config SPL_MMC_SUPPORT
	default y if DM_MMC

config SPL_NAND_SUPPORT
	default y if SPL_NAND_DENALI

config SPL_SERIAL_SUPPORT
	default y

config SPL_SPI_FLASH_SUPPORT
	default y if SPL_SPI_SUPPORT

config SPL_SPI_SUPPORT
	default y if DM_SPI

config SPL_WATCHDOG_SUPPORT
	default y

config SYS_MMCSD_RAW_MODE_U_BOOT_USE_PARTITION_TYPE
	default y

config SYS_MMCSD_RAW_MODE_U_BOOT_PARTITION_TYPE
	default 0xa2

config ARMV8_PSCI_NR_CPUS
	default 4 if TARGET_SOCFPGA_STRATIX10

config ARMV8_SECURE_BASE
	default 0xffe20000 if TARGET_SOCFPGA_STRATIX10

config SYS_HAS_ARMV8_SECURE_BASE
	default y if TARGET_SOCFPGA_STRATIX10

config TARGET_SOCFPGA_ARRIA5
	bool
	select TARGET_SOCFPGA_GEN5

config TARGET_SOCFPGA_ARRIA10
	bool
	select SPL_BOARD_INIT if SPL

config TARGET_SOCFPGA_CYCLONE5
	bool
	select TARGET_SOCFPGA_GEN5

config TARGET_SOCFPGA_GEN5
	bool
	select ALTERA_SDRAM

config TARGET_SOCFPGA_STRATIX10
	bool
	select ARMV8_MULTIENTRY
	select ARMV8_SET_SMPEN
	select ARMV8_PSCI
	select ARMV8_SEC_FIRMWARE_SUPPORT

choice
	prompt "Altera SOCFPGA board select"
	optional

config TARGET_SOCFPGA_ARRIA10_SOCDK
	bool "Altera SOCFPGA SoCDK (Arria 10)"
	select TARGET_SOCFPGA_ARRIA10

config TARGET_SOCFPGA_ARRIA5_SOCDK
	bool "Altera SOCFPGA SoCDK (Arria V)"
	select TARGET_SOCFPGA_ARRIA5

config TARGET_SOCFPGA_CYCLONE5_SOCDK
	bool "Altera SOCFPGA SoCDK (Cyclone V)"
	select TARGET_SOCFPGA_CYCLONE5

config TARGET_SOCFPGA_ARIES_MCVEVK
	bool "Aries MCVEVK (Cyclone V)"
	select TARGET_SOCFPGA_CYCLONE5

config TARGET_SOCFPGA_EBV_SOCRATES
	bool "EBV SoCrates (Cyclone V)"
	select TARGET_SOCFPGA_CYCLONE5

config TARGET_SOCFPGA_IS1
	bool "IS1 (Cyclone V)"
	select TARGET_SOCFPGA_CYCLONE5

config TARGET_SOCFPGA_SAMTEC_VINING_FPGA
	bool "samtec VIN|ING FPGA (Cyclone V)"
	select BOARD_LATE_INIT
	select TARGET_SOCFPGA_CYCLONE5

config TARGET_SOCFPGA_SR1500
	bool "SR1500 (Cyclone V)"
	select TARGET_SOCFPGA_CYCLONE5

config TARGET_SOCFPGA_STRATIX10_SOCDK
	bool "Intel SOCFPGA SoCDK (Stratix 10)"
	select TARGET_SOCFPGA_STRATIX10

config TARGET_SOCFPGA_TERASIC_DE0_NANO
	bool "Terasic DE0-Nano-Atlas (Cyclone V)"
	select TARGET_SOCFPGA_CYCLONE5

config TARGET_SOCFPGA_TERASIC_DE10_NANO
	bool "Terasic DE10-Nano (Cyclone V)"
	select TARGET_SOCFPGA_CYCLONE5

config TARGET_SOCFPGA_TERASIC_DE1_SOC
	bool "Terasic DE1-SoC (Cyclone V)"
	select TARGET_SOCFPGA_CYCLONE5

config TARGET_SOCFPGA_TERASIC_SOCKIT
	bool "Terasic SoCkit (Cyclone V)"
	select TARGET_SOCFPGA_CYCLONE5

endchoice

config SYS_BOARD
	default "arria5-socdk" if TARGET_SOCFPGA_ARRIA5_SOCDK
	default "arria10-socdk" if TARGET_SOCFPGA_ARRIA10_SOCDK
	default "cyclone5-socdk" if TARGET_SOCFPGA_CYCLONE5_SOCDK
	default "de0-nano-soc" if TARGET_SOCFPGA_TERASIC_DE0_NANO
	default "de1-soc" if TARGET_SOCFPGA_TERASIC_DE1_SOC
	default "de10-nano" if TARGET_SOCFPGA_TERASIC_DE10_NANO
	default "is1" if TARGET_SOCFPGA_IS1
	default "mcvevk" if TARGET_SOCFPGA_ARIES_MCVEVK
	default "sockit" if TARGET_SOCFPGA_TERASIC_SOCKIT
	default "socrates" if TARGET_SOCFPGA_EBV_SOCRATES
	default "sr1500" if TARGET_SOCFPGA_SR1500
	default "stratix10-socdk" if TARGET_SOCFPGA_STRATIX10_SOCDK
	default "vining_fpga" if TARGET_SOCFPGA_SAMTEC_VINING_FPGA

config SYS_VENDOR
	default "altera" if TARGET_SOCFPGA_ARRIA5_SOCDK
	default "altera" if TARGET_SOCFPGA_ARRIA10_SOCDK
	default "altera" if TARGET_SOCFPGA_CYCLONE5_SOCDK
	default "altera" if TARGET_SOCFPGA_STRATIX10_SOCDK
	default "aries" if TARGET_SOCFPGA_ARIES_MCVEVK
	default "ebv" if TARGET_SOCFPGA_EBV_SOCRATES
	default "samtec" if TARGET_SOCFPGA_SAMTEC_VINING_FPGA
	default "terasic" if TARGET_SOCFPGA_TERASIC_DE0_NANO
	default "terasic" if TARGET_SOCFPGA_TERASIC_DE1_SOC
	default "terasic" if TARGET_SOCFPGA_TERASIC_DE10_NANO
	default "terasic" if TARGET_SOCFPGA_TERASIC_SOCKIT

config SYS_SOC
	default "socfpga"

config SYS_CONFIG_NAME
	default "socfpga_arria5_socdk" if TARGET_SOCFPGA_ARRIA5_SOCDK
	default "socfpga_arria10_socdk" if TARGET_SOCFPGA_ARRIA10_SOCDK
	default "socfpga_cyclone5_socdk" if TARGET_SOCFPGA_CYCLONE5_SOCDK
	default "socfpga_de0_nano_soc" if TARGET_SOCFPGA_TERASIC_DE0_NANO
	default "socfpga_de1_soc" if TARGET_SOCFPGA_TERASIC_DE1_SOC
	default "socfpga_de10_nano" if TARGET_SOCFPGA_TERASIC_DE10_NANO
	default "socfpga_is1" if TARGET_SOCFPGA_IS1
	default "socfpga_mcvevk" if TARGET_SOCFPGA_ARIES_MCVEVK
	default "socfpga_sockit" if TARGET_SOCFPGA_TERASIC_SOCKIT
	default "socfpga_socrates" if TARGET_SOCFPGA_EBV_SOCRATES
	default "socfpga_sr1500" if TARGET_SOCFPGA_SR1500
	default "socfpga_stratix10_socdk" if TARGET_SOCFPGA_STRATIX10_SOCDK
	default "socfpga_vining_fpga" if TARGET_SOCFPGA_SAMTEC_VINING_FPGA

endif
```

## board/altera/arria10-socdk/fit_uboot.its
```
// SPDX-License-Identifier: GPL-2.0
 /*
 * Copyright (C) 2019 Intel Corporation <www.intel.com>
 *
 */

/dts-v1/;

/ {
	description = "FIT image with boot binaries";
	#address-cells = <1>;

	images {
		uboot {
			description = "U-Boot (32-bit)";
			data = /incbin/("../../../u-boot-dtb.bin");
			type = "standalone";
			os = "U-Boot";
			arch = "arm";
			compression = "none";
			load = <0x01000040>;
			entry = <0x01000040>;
		};
	};

	configurations {
		default = "conf";
		conf {
			description = "Intel Arria10 SoCDK";
			loadables = "uboot";
		};
	};
};
```

## board/altera/soc64/its/kernel_vab.its
```
/*
 * Copyright (C) 2020 Intel Corporation. All rights reserved
 *
 * SPDX-License-Identifier: GPL-2.0+
 */

/dts-v1/;

/ {
	description = "FIT with VAB signed Linux kernel image and FDT blob";
	#address-cells = <1>;

	images {
		kernel {
			description = "Signed Linux Kernel";
			data = /incbin/("../../../../signed_Image");
			type = "kernel";
			arch = "arm64";
			os = "linux";
			compression = "none";
			load = <0x4080000>;
			entry = <0x4080000>;
		};
		fdt {
			description = "Signed Linux DTB";
			data = /incbin/("../../../../signed_linux.dtb");
			type = "flat_dt";
			arch = "arm64";
			compression = "none";
		};
	};
	configurations {
		default = "conf";
		conf {
			description = "VAB signed Linux boot configuration";
			kernel = "kernel";
			fdt = "fdt";
		};
	};
};
```

## board/altera/stratix10-socdk/its/kernel-sign.its
```
/*
 * Copyright (C) 2019 Intel Corporation. All rights reserved
 *
 * SPDX-License-Identifier: GPL-2.0
 */

/dts-v1/;

/ {
	description = "Linux kernel image with FDT blob";
	#address-cells = <1>;

	images {
		kernel {
			description = "Linux Kernel";
			data = /incbin/("Image");
			type = "kernel";
			arch = "arm64";
			os = "linux";
			compression = "none";
			load = <0x2080000>;
			entry = <0x2080000>;
			hash {
				algo = "sha256";
			};
		};
		fdt {
			description = "Linux DTB";
			data = /incbin/("socfpga_stratix10_socdk.dtb");
			type = "flat_dt";
			arch = "arm64";
			compression = "none";
			hash {
				algo = "sha256";
			};
		};
	};
	configurations {
		default = "conf";
		conf {
			description = "Linux boot configuration";
			kernel = "kernel";
			fdt = "fdt";
			signature {
				algo = "sha256,rsa4096";
				key-name-hint = "dev";
				sign-images = "fdt", "kernel";
			};
		};
	};
};
```

## board/altera/stratix10-socdk/its/uboot-sign.its
```
/*
 * Copyright (C) 2019 Intel Corporation. All rights reserved
 *
 * SPDX-License-Identifier: GPL-2.0
 */

/dts-v1/;

/ {
	description = "Authenticator";
	#address-cells = <1>;

	images {
		standalone {
			description = "Authenticator binary";
			data = /incbin/("../../../../u-boot-dtb.bin");
			type = "standalone";
			arch = "arm64";
			compression = "none";
			load = <0x1000>;
			entry = <0x1000>;
			os = "u-boot";
			hash {
				algo = "sha256";
			};
		};
	};

	configurations {
		default = "conf";
		conf {
			description = "Authenticator fitImage";
			standalone = "standalone";
			signature {
				algo = "sha256,rsa4096";
				key-name-hint = "dev";
				sign-images = "standalone";
			};
		};
	};
};
```

## board/terasic/arria10-hanpilot/fit_spl_hanpilot_fpga.its
```
// SPDX-License-Identifier: GPL-2.0
 /*
 * Copyright (C) 2019 Intel Corporation <www.intel.com>
 *
 */

/dts-v1/;

/ {
	description = "FIT image with FPGA bistream";
	#address-cells = <1>;

	images {
		fpga-periph-1 {
			description = "FPGA peripheral bitstream";
			data = /incbin/("../../../hanpilot.periph.rbf");
			type = "fpga";
			arch = "arm";
			compression = "none";
		};

		fpga-core-1 {
			description = "FPGA core bitstream";
			data = /incbin/("../../../hanpilot.core.rbf");
			type = "fpga";
			arch = "arm";
			compression = "none";
		};
	};

	configurations {
		default = "config-1";
		config-1 {
			description = "Boot with FPGA early IO release config";
			fpga = "fpga-periph-1", "fpga-core-1";
		};
	};
};
```

## configs/socfpga_agilex5_emmc_defconfig
```kconfig
#include <configs/socfpga_agilex5_defconfig>

CONFIG_DEFAULT_DEVICE_TREE="socfpga_agilex5_socdk_emmc"
CONFIG_TARGET_SOCFPGA_AGILEX5_EMMC=y
CONFIG_SPL_DM_REGULATOR_GPIO=n
CONFIG_DM_REGULATOR_GPIO=n
CONFIG_SPL_MMC_UHS_SUPPORT=n
CONFIG_MMC_UHS_SUPPORT=n
CONFIG_SPL_DWAPB_GPIO=n
```

## configs/socfpga_agilex_edge_emu_defconfig
```kconfig
CONFIG_ARM=y
CONFIG_SPL_LDSCRIPT="arch/arm/mach-socfpga/u-boot-spl-soc64.lds"
CONFIG_ARCH_SOCFPGA=y
CONFIG_SYS_TEXT_BASE=0x80200000
CONFIG_SYS_MALLOC_F_LEN=0x2000
CONFIG_NR_DRAM_BANKS=2
CONFIG_ENV_SIZE=0x2000
CONFIG_DM_GPIO=y
# CONFIG_SPL_DM_SPI is not set
CONFIG_DEFAULT_DEVICE_TREE="socfpga_agilex_edge_emu"
# CONFIG_SPL_MMC is not set
CONFIG_TARGET_SOCFPGA_AGILEX_EDGE_SIMICS=n
CONFIG_TARGET_SOCFPGA_AGILEX_EDGE_EMU=y
CONFIG_TARGET_SOCFPGA_AGILEX_EDGE_SOCDK=y
CONFIG_IDENT_STRING="socfpga_agilex_edge"
CONFIG_SPL_FS_FAT=y
# CONFIG_SPL_SPI is not set
CONFIG_ARMV8_SPL_EXCEPTION_VECTORS=y
CONFIG_DISTRO_DEFAULTS=y
CONFIG_FIT=y
CONFIG_SPL_FIT_SIGNATURE=y
CONFIG_SPL_LOAD_FIT=y
CONFIG_SPL_LOAD_FIT_ADDRESS=0x82000000
# CONFIG_USE_SPL_FIT_GENERATOR is not set
CONFIG_QSPI_BOOT=y
CONFIG_BOOTDELAY=5
CONFIG_USE_BOOTARGS=y
CONFIG_BOOTARGS="earlycon panic=-1"
CONFIG_LEGACY_IMAGE_FORMAT=y
# CONFIG_SPL_RAW_IMAGE_SUPPORT is not set
CONFIG_SPL_CRC32=y
CONFIG_SPL_CACHE=y
# CONFIG_SPL_DM_SPI_FLASH is not set
CONFIG_SPL_ATF=y
CONFIG_SPL_ATF_NO_PLATFORM_PARAM=y
CONFIG_SYS_PROMPT="SOCFPGA_AGILEX_EDGE # "
CONFIG_CMD_NVEDIT_SELECT=y
CONFIG_CMD_MEMTEST=y
CONFIG_CMD_GPIO=y
CONFIG_CMD_I2C=y
CONFIG_CMD_MMC=y
CONFIG_CMD_MTD=y
CONFIG_CMD_NAND_TRIMFFS=y
CONFIG_CMD_NAND_LOCK_UNLOCK=y
CONFIG_CMD_SPI=y
CONFIG_CMD_USB=y
CONFIG_CMD_CACHE=y
CONFIG_MTDIDS_DEFAULT="nand0=ffb90000.nand.0"
CONFIG_MTDPARTS_DEFAULT="mtdparts=ffb90000.nand.0:2m(u-boot),-(root)"
CONFIG_CMD_UBI=y
# CONFIG_ISO_PARTITION is not set
# CONFIG_EFI_PARTITION is not set
CONFIG_OF_LIST=""
CONFIG_SYS_RELOC_GD_ENV_ADDR=y
CONFIG_NET_RANDOM_ETHADDR=y
CONFIG_SPL_DM_SEQ_ALIAS=y
CONFIG_SPL_ALTERA_SDRAM=y
CONFIG_FPGA_INTEL_PR=y
CONFIG_DWAPB_GPIO=y
CONFIG_DM_I2C=y
CONFIG_SYS_I2C_DW=y
CONFIG_MISC=y
CONFIG_MMC_DW=y
CONFIG_MTD=y
CONFIG_DM_MTD=y
CONFIG_NAND_DENALI_DT=y
CONFIG_SYS_NAND_U_BOOT_LOCATIONS=y
CONFIG_SYS_NAND_U_BOOT_OFFS=0x0
CONFIG_SYS_NAND_U_BOOT_OFFS_REDUND=0x100000
CONFIG_SPL_NAND_FRAMEWORK=y
CONFIG_SF_DEFAULT_MODE=0x2003
CONFIG_SPI_FLASH_SPANSION=y
CONFIG_SPI_FLASH_STMICRO=y
CONFIG_UBI_SILENCE_MSG=y
CONFIG_PHY_MICREL=y
CONFIG_PHY_MICREL_KSZ90X1=y
CONFIG_DM_ETH=y
CONFIG_ETH_DESIGNWARE=y
CONFIG_MII=y
CONFIG_DM_RESET=y
CONFIG_BAUDRATE=4800
CONFIG_SPI=y
CONFIG_CADENCE_QSPI=y
CONFIG_DESIGNWARE_SPI=y
CONFIG_USB=y
CONFIG_USB_DWC2=y
# CONFIG_SPL_WDT is not set
CONFIG_UBIFS_SILENCE_MSG=y
# CONFIG_SPL_USE_TINY_PRINTF is not set
CONFIG_PANIC_HANG=y
CONFIG_BOOTCOMMAND="printenv bootcmd; setenv bootargs console=ttyS0,4800 initrd=0x90000000 root=/dev/ram0 rw init=/sbin/init ramdisk_size=10000000 earlycon panic=-1 nosmp kvm-arm.mode=nvhe\r; booti 0x86000000 0x90000000 0x8c000000"
CONFIG_SYS_LOAD_ADDR=0x82000000
```

## configs/socfpga_arria10_defconfig
```kconfig
+S:CONFIG_ARM=y
+S:CONFIG_TARGET_SOCFPGA_ARRIA10=y
CONFIG_OF_CONTROL=y
CONFIG_DEFAULT_DEVICE_TREE="socfpga_arria10"
CONFIG_SKIP_LOWLEVEL_INIT=n
CONFIG_CADENCE_QSPI=n
CONFIG_MMC=y
```

## configs/socfpga_arria10_nand_defconfig
```kconfig
CONFIG_ARM=y
CONFIG_ARCH_SOCFPGA=y
CONFIG_SYS_TEXT_BASE=0x01000040
CONFIG_SYS_MALLOC_F_LEN=0x4000
CONFIG_SPL_SYS_MALLOC_F_LEN=0x2000
CONFIG_SPL_CLEAR_BSS_F=y
CONFIG_TARGET_SOCFPGA_ARRIA10_SOCDK=y
CONFIG_SPL=y
CONFIG_IDENT_STRING="socfpga_arria10"
CONFIG_DISTRO_DEFAULTS=n
CONFIG_NR_DRAM_BANKS=1
CONFIG_USE_BOOTARGS=y
CONFIG_BOOTARGS="console=ttyS0,115200 "
CONFIG_USE_BOOTCOMMAND=y
CONFIG_BOOTCOMMAND="bridge enable; run nandload; run nandboot"
CONFIG_BOOTDELAY=5
CONFIG_CMD_BOOTZ=y
CONFIG_NAND_BOOT=y
CONFIG_CMD_XIMG=y
CONFIG_CMD_UNZIP=y
CONFIG_GZIP_COMPRESSED=y
CONFIG_SYS_CONSOLE_IS_IN_ENV=y
CONFIG_SYS_CONSOLE_OVERWRITE_ROUTINE=y
CONFIG_SYS_CONSOLE_ENV_OVERWRITE=y
CONFIG_DEFAULT_FDT_FILE="socfpga_arria10_socdk_nand.dtb"
CONFIG_VERSION_VARIABLE=y
CONFIG_DISPLAY_BOARDINFO_LATE=y
CONFIG_BOUNCE_BUFFER=y
CONFIG_SPL_FPGA_SUPPORT=y
CONFIG_CMD_ASKENV=y
CONFIG_CMD_GREPENV=y
# CONFIG_CMD_FLASH is not set
CONFIG_CMD_GPIO=y
CONFIG_CMD_CACHE=y
CONFIG_MTD=y
CONFIG_SPL_MTD_SUPPORT=y
CONFIG_NAND_DENALI_DT=y
CONFIG_SPL_NAND_FRAMEWORK=y
CONFIG_SPL_NAND_SUPPORT=y
CONFIG_NAND_DENALI_SPARE_AREA_SKIP_BYTES=2
CONFIG_CMD_NAND_LOCK_UNLOCK=y
CONFIG_CMD_NAND_TRIMFFS=y
CONFIG_MTDIDS_DEFAULT="nand0=ffb80000.nand.0"
CONFIG_SPI=y
CONFIG_CMD_SPI=y
CONFIG_CMD_SF=y
CONFIG_ENV_IS_IN_NAND=y
CONFIG_SPL_ENV_SUPPORT=y
CONFIG_SPL_ENV_IS_NOWHERE=y
CONFIG_SPI_FLASH=y
CONFIG_SPI_FLASH_STMICRO=y
CONFIG_OF_SPL_REMOVE_PROPS="interrupts interrupt-parent dmas dma-names"
CONFIG_DEFAULT_DEVICE_TREE="socfpga_arria10_socdk_nand"
CONFIG_SPL_DRIVERS_MISC_SUPPORT=y
CONFIG_SPL_DM=y
CONFIG_SPL_DM_SEQ_ALIAS=y
CONFIG_MISC=y
CONFIG_DOS_PARTITION=n
CONFIG_CMD_FAT=n
CONFIG_FAT_WRITE=n
CONFIG_SPL_MMC_SUPPORT=n
CONFIG_MMC=n
CONFIG_SPL_ZLIB=n
CONFIG_SPL_GZIP=n
CONFIG_SPL_LZO=n
CONFIG_FS_LOADER=y
CONFIG_FPGA_SOCFPGA=y
CONFIG_SPL_FIT=y
CONFIG_FIT=y
CONFIG_FIT_VERBOSE=y
CONFIG_SPL_LOAD_FIT=y
CONFIG_SPL_FIT_SOURCE="board/altera/arria10-socdk/fit_spl_uboot.its"
CONFIG_DM_GPIO=y
CONFIG_DWAPB_GPIO=y
CONFIG_PHY_MICREL=y
CONFIG_PHY_MICREL_KSZ90X1=y
CONFIG_CMD_DHCP=y
CONFIG_DM_ETH=y
CONFIG_ETH_DESIGNWARE=y
CONFIG_MII=y
CONFIG_NET_RANDOM_ETHADDR=y
CONFIG_SYS_NS16550=y
CONFIG_TIMER=y
CONFIG_SPL_TIMER=y
CONFIG_DESIGNWARE_APB_TIMER=y
```
